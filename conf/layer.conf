## conf/layer.conf
```bitbake
# We have a conf and classes directory, add to BBPATH
BBPATH := "${LAYERDIR}:${BBPATH}"

# We have a packages directory, add to BBFILES
BBFILES := "${BBFILES} ${LAYERDIR}/recipes-*/*/*.bb \
            ${LAYERDIR}/recipes-*/*/*.bbappend"

BBFILE_COLLECTIONS += "magpie"
BBFILE_PATTERN_magpie := "^${LAYERDIR}/"
BBFILE_PRIORITY_magpie = "5"

# we want the good jpeg lib, not the ijg stuff
PREFERRED_PROVIDER_jpeg ?= "libjpeg-turbo"

# ...and the good ffmpeg...
PREFERRED_PROVIDER_ffmpeg ?= "ffmpeg"
# to get this we need to...
LICENSE_FLAGS_WHITELIST ?= "commercial"
```

## meta-magpie/conf/layer.conf
```bitbake
# We have a conf and classes directory, append to BBPATH
BBPATH .= ":${LAYERDIR}"

# We have a recipes directory, add to BBFILES
BBFILES += "${LAYERDIR}/recipes-*/*/*.bb ${LAYERDIR}/recipes-*/*/*.bbappend"

BBFILE_COLLECTIONS += "magpie-layer"
BBFILE_PATTERN_magpie-layer := "^${LAYERDIR}/"
BBFILE_PRIORITY_magpie-layer = "7"

MAGPIE_BASE := '${@os.path.normpath("${LAYERDIR}/../")}'
```
